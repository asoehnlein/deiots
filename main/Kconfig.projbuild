## main/Kconfig.projbuild
```kconfig
menu "MQTT Broker Configuration"

    config MQTT_BROKER_URI
        string "mqtt broker url endpoint"
        default "mqtts://172.16.11.202:8883"
        help
            URL of server which hosts the MQTT Broker

    config MQTT_BROKER_TOPIC
        string "mqtt default topic"
        default "/sensor/bmp280"
        help
            Specify the Topic to publish sensor values

endmenu


menu "OTA Configuration"

    config EXAMPLE_FIRMWARE_UPGRADE_URL
        string "firmware upgrade url endpoint"
        default "https://172.16.11.202:8070/deiots.bin"
        help
            URL of server which hosts the firmware
            image.

endmenu

menu "Sensor Configuration"

config I2C_ADDRESS
    hex "I2C_ADDRESS (Default 0x76 | 0x77)"
        default 0x76

config SCL_GPIO
    int "SCL_GPIO (Default 22)"
        default 22

config SDA_GPIO
    int "SDA_GPIO (Default 21)"
        default 21

endmenu


menu "SoftAP Configuration"

    config EXAMPLE_SSID_SET_MAC
        bool "Use MAC as SSID"
        default y
        help
            Set SoftAP SSID as PROV_<MAC>.

    config EXAMPLE_SSID
        string "Wi-Fi SSID"
        default "PROV_SSID"
        depends on !EXAMPLE_SSID_SET_MAC
        help
            SSID (network name) for the example to connect to.

    config EXAMPLE_PASS
        string "Wi-Fi Password"
        default "PROV_PASS"
        help
            Wi-Fi password (WPA or WPA2) for the example to use.

    config EXAMPLE_USE_SEC_1
        bool
        default y
        prompt "Use Security Version 1"
        help
            Security version 1 used Curve25519 key exchange for establishing
            secure session between device and client during provisioning

    config EXAMPLE_USE_POP
        bool
        depends on EXAMPLE_USE_SEC_1
        default y
        prompt "Use proof-of-possession"
        help
            Proof-of-possession can be optionally used to prove that the device is indeed
            in possession of the user who is provisioning the device. This proof-of-possession
            is internally used to generate the shared secret through key exchange.

    config EXAMPLE_POP
        string "Proof-of-possession"
        default "abcd1234"
        depends on EXAMPLE_USE_POP

    config EXAMPLE_RESET_PROVISIONED
        bool
        default n
        prompt "Reset provisioned status of the device"
        help
            This erases the NVS to reset provisioned status of the device on every reboot.
            Provisioned status is determined by the Wi-Fi STA configuration, saved on the NVS.

    config EXAMPLE_AP_RECONN_ATTEMPTS
        int "Maximum AP connection attempts"
        default 5
        help
            Set the maximum connection attempts to perform when connecting to a Wi-Fi AP.

endmenu
```
